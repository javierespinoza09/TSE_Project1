## Yocto_Sources/conf/bblayers.conf
```bitbake
# POKY_BBLAYERS_CONF_VERSION is increased each time build/conf/bblayers.conf
# changes incompatibly
POKY_BBLAYERS_CONF_VERSION = "2"

BBPATH = "${TOPDIR}"
BBFILES ?= ""

BBLAYERS ?= " \
  /home/javier/poky/meta \
  /home/javier/poky/meta-poky \
  /home/javier/poky/meta-yocto-bsp \
  /home/javier/Yocto/meta-newlayer \
  "
```

## Yocto_Sources/meta-newlayer/conf/layer.conf
```bitbake
# We have a conf and classes directory, add to BBPATH
BBPATH .= ":${LAYERDIR}"

# We have recipes-* directories, add to BBFILES
BBFILES += "${LAYERDIR}/recipes-*/*/*.bb \
            ${LAYERDIR}/recipes-*/*/*.bbappend"

BBFILE_COLLECTIONS += "meta-newlayer"
BBFILE_PATTERN_meta-newlayer = "^${LAYERDIR}/"
BBFILE_PRIORITY_meta-newlayer = "6"

LAYERDEPENDS_meta-newlayer = "core"
LAYERSERIES_COMPAT_meta-newlayer = "kirkstone langdale dunfell"
```
